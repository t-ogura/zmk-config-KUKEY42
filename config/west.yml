## config/west.yml
```yaml
manifest:
  defaults:
    revision: main
  remotes:
    - name: zmkfirmware
      url-base: https://github.com/zmkfirmware
    - name: cormoran
      url-base: https://github.com/cormoran
    - name: r-Keys-kbd
      url-base: https://github.com/r-Keys-kbd
    - name: caksoylar
      url-base: https://github.com/caksoylar
    # - name: prospector
    #   url-base: https://github.com/t-ogura
  projects:
    # ZMK: cormoran fork with custom RPC subsystem for DYA Studio
    - name: zmk
      remote: cormoran
      revision: v0.3-branch+dya
      import: app/west.yml
    # Trackball driver
    - name: zmk-pmw3610-driver
      remote: r-Keys-kbd
      revision: main
    # RGB LED widget
    - name: zmk-rgbled-widget
      remote: caksoylar
      revision: main
    # Prospector: disabled for DYA Studio compatibility
    # - name: prospector-zmk-module
    #   remote: prospector
    #   revision: v2.0.0
    #   path: modules/prospector-zmk-module
    # DYA Studio modules
    - name: zmk-module-ble-management
      remote: cormoran
    - name: zmk-module-battery-history
      remote: cormoran
    - name: zmk-module-settings-rpc
      remote: cormoran
    - name: zmk-module-runtime-input-processor
      remote: cormoran
  self:
    path: config
```
